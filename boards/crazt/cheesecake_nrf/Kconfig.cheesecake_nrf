## boards/crazt/cheesecake_nrf/Kconfig.cheesecake_nrf
```kconfig
# Copyright (c) 2026
# SPDX-License-Identifier: Apache-2.0

config BOARD_CHEESECAKE_NRF
	select SOC_NRF52840_QIAA
	select BOARD_EARLY_INIT_HOOK

config BOARD_CHEESECAKE_NRF_DEV
	bool
	default y if BOARD_CHEESECAKE_NRF_NRF52840_DEV

config BOARD_CHEESECAKE_NRF_UF2
	bool
	default y if BOARD_CHEESECAKE_NRF_NRF52840_UF2
```

## boards/crazt/cheesecake_nrf/board.yml
```yaml
# Copyright (c) 2026
# SPDX-License-Identifier: Apache-2.0

board:
  name: cheesecake_nrf
  vendor: crazt
  socs:
    - name: nrf52840
      variants:
      - name: 'dev'
      - name: 'uf2'
```

## boards/crazt/cheesecake_nrf/cheesecake_nrf_dev_defconfig
```kconfig
# Copyright (c) 2026
# SPDX-License-Identifier: Apache-2.0

CONFIG_ARM_MPU=y
CONFIG_HW_STACK_PROTECTION=y

CONFIG_USB_DEVICE_STACK=y
CONFIG_USB_DEVICE_MANUFACTURER="SlimeVR"
CONFIG_USB_DEVICE_PRODUCT="SlimeNRF Tracker CheeseCake_NRF Dev"

CONFIG_BATTERY_USE_REG_LDO_MAPPING=y
CONFIG_LED_RGB_COLOR=y
CONFIG_LED_DEFAULT_COLOR_R=0
CONFIG_LED_DEFAULT_COLOR_G=7000
CONFIG_LED_DEFAULT_COLOR_B=10000
CONFIG_LED_MAX_BRIGHTNESS=2500
CONFIG_LED_WHITE_MAX_BRIGHTNESS=1000

# Development image: no UF2 bootloader, no SoftDevice, app starts at flash base.
# CONFIG_BUILD_OUTPUT_UF2 is not set
CONFIG_FLASH_LOAD_OFFSET=0x0
```

## boards/crazt/cheesecake_nrf/cheesecake_nrf_uf2_defconfig
```kconfig
# Copyright (c) 2026
# SPDX-License-Identifier: Apache-2.0

CONFIG_ARM_MPU=y
CONFIG_HW_STACK_PROTECTION=y

CONFIG_USB_DEVICE_STACK=y
CONFIG_USB_DEVICE_MANUFACTURER="SlimeVR"
CONFIG_USB_DEVICE_PRODUCT="SlimeNRF Tracker CheeseCake_NRF"

CONFIG_BATTERY_USE_REG_LDO_MAPPING=y
CONFIG_LED_RGB_COLOR=y

# Experimental TCAL Heat settings
CONFIG_SYSTEM_IMU_HEATER_MAX_DUTY_PPTT=9900
CONFIG_SENSOR_TCAL_HEATED_DEFAULT_KP=300
CONFIG_SENSOR_TCAL_HEATED_DEFAULT_KI=5
CONFIG_SENSOR_TCAL_HEATED_DEFAULT_KFF=420

# Generate for Adafruit UF2 bootloader flashing.
CONFIG_BUILD_OUTPUT_UF2=y
CONFIG_BUILD_OUTPUT_UF2_FAMILY_ID="0xADA52840"
CONFIG_FLASH_LOAD_OFFSET=0x1000
```

## boards/crazt/e73_tracker/board.yml
```yaml
# Copyright (c) 2026
# SPDX-License-Identifier: Apache-2.0

board:
  name: e73_tracker
  vendor: crazt
  socs:
    - name: nrf52840
      variants:
      - name: 'dev'
      - name: 'uf2'
```

## boards/crazt/e73_tracker_dev/Kconfig.e73_tracker_dev
```kconfig
# Copyright (c) 2026
# SPDX-License-Identifier: Apache-2.0

config BOARD_E73_TRACKER_DEV
	select SOC_NRF52840_QIAA
```

## boards/crazt/e73_tracker_dev/board.yml
```yaml
# Copyright (c) 2026
# SPDX-License-Identifier: Apache-2.0

board:
  name: e73_tracker_dev
  vendor: crazt
  socs:
    - name: nrf52840
```

## boards/crazt/e73_tracker_uf2/board.yml
```yaml
# Copyright (c) 2024 Nordic Semiconductor ASA
# SPDX-License-Identifier: Apache-2.0

board:
  name: e73_tracker_uf2
  vendor: crazt
  socs:
    - name: nrf52840
```

## dts/bindings/led_strip/slimevr,ws2812-spi-packed.yaml
```yaml
# Copyright (c) 2026
# SPDX-License-Identifier: Apache-2.0

description: |
  SlimeVR WS2812 LED strip SPI driver with packed symbols.

  This binding is intended for nRF52 SPIM instances that only support 8-bit SPI
  words and fixed 4/8 MHz clock steps. The driver packs multiple SPI bits into a
  continuous byte stream, allowing 5-bit WS2812 symbols at 4 MHz.

compatible: "slimevr,ws2812-spi-packed"

include: [spi-device.yaml, ws2812.yaml]

properties:
  bits-per-symbol:
    type: int
    required: true
    description: Number of SPI bits used to encode one WS2812 data bit.

  spi-one-frame:
    type: int
    required: true
    description: Symbol bits to shift out for a WS2812 1 bit.

  spi-zero-frame:
    type: int
    required: true
    description: Symbol bits to shift out for a WS2812 0 bit.
```
